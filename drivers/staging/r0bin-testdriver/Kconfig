## drivers/staging/r0bin-testdriver/Kconfig
```kconfig
#
#	Restricted Access Register Manager
#
config R0BINTESTDRIVER
	tristate "RobinTestDriver"
	default n
	---help---
		Test driver for photon devs.
		
```
